#include <zephyr/dt-bindings/dma/sf32lb-dma-config.h>
#include <zephyr/dt-bindings/dma/sf32lb52x-dma.h>

/ {
	aliases {
		i2s-node0 = &i2s1;
	};
};

&i2s1 {
	dmas = <&dmac 2 SF32LB52X_DMA_REQ_I2S1_TX SF32LB_DMA_PL_HIGH>,
	       <&dmac 3 SF32LB52X_DMA_REQ_I2S1_RX SF32LB_DMA_PL_HIGH>;
	dma-names = "tx", "rx";
};