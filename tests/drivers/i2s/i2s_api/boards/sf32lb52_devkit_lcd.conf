## tests/drivers/i2s/i2s_api/boards/sf32lb52_devkit_lcd.conf
```kconfig
CONFIG_TEST_USERSPACE=n
CONFIG_I2S_TEST_USE_GPIO_LOOPBACK=y
CONFIG_LOG_DEFAULT_LEVEL=4
CONFIG_I2S_TEST_ALLOWED_DATA_OFFSET=24
CONFIG_I2S_TEST_ALLOW_VARIABLE_OFFSET=y
```

## tests/drivers/uart/uart_interrupt_api/testcase.yaml
```yaml
tests:
  drivers.uart.interrupt_api:
    tags:
      - uart
    filter: CONFIG_SERIAL_SUPPORT_INTERRUPT
    vendor_allow:
      - adi
      - sifli   # 添加SiFli厂商的允许列表

    harness: console  # <--- 使用 console harness
    harness_config:   # <--- 配置控制台匹配规则
      type: one_line  # 逐行匹配
      regex:          # 匹配包含 "This is a FIFO test." 的行
        - "This is a FIFO test."
```
