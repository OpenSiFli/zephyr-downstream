/ {
	aliases {

		eeprom-0 = &eeprom0;
	};
};


&i2c1 {
	status = "okay";

	clock-frequency = <I2C_BITRATE_FAST>;


	/*
	 * On-board EEPROM is an AT24C32 (32 Kbit = 4096 bytes, 32-byte page,
	 * 2-byte word address).
	 */
	eeprom0: eeprom@50 {
		compatible = "atmel,at24";

		reg = <0x50>;
		size = <4096>;
		pagesize = <32>;
		address-width = <16>;
		timeout = <5>;
	};
};
