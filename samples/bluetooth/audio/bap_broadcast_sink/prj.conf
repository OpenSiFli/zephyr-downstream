## prj.conf
```kconfig
CONFIG_BT=y
CONFIG_LOG=y
CONFIG_UTF8=y
CONFIG_SHELL=y
CONFIG_SHELL_BACKEND_SERIAL=y
CONFIG_BT_AUDIO=y
CONFIG_BT_SMP=y
CONFIG_BT_PAC_SNK=y
CONFIG_BT_PERIPHERAL=y
CONFIG_BT_GAP_AUTO_UPDATE_CONN_PARAMS=n
# Set preferred values based on BT_BAP_CONN_PARAM_RELAXED
CONFIG_BT_PERIPHERAL_PREF_MIN_INT=50
CONFIG_BT_PERIPHERAL_PREF_MAX_INT=70
CONFIG_BT_PERIPHERAL_PREF_LATENCY=0
CONFIG_BT_PERIPHERAL_PREF_TIMEOUT=400
CONFIG_BT_OBSERVER=y
CONFIG_BT_GATT_DYNAMIC_DB=y
CONFIG_BT_EXT_ADV=y
CONFIG_BT_PER_ADV_SYNC=y
CONFIG_BT_ISO_SYNC_RECEIVER=y
CONFIG_BT_BAP_BROADCAST_SINK=y
CONFIG_BT_BAP_SCAN_DELEGATOR=y
CONFIG_BT_ISO_MAX_CHAN=2
# Allocate 4 RX buffers per channel
CONFIG_BT_ISO_RX_BUF_COUNT=8
CONFIG_BT_ISO_TX_BUF_COUNT=5
CONFIG_BT_BAP_BROADCAST_SNK_SUBGROUP_COUNT=2
CONFIG_BT_BAP_BROADCAST_SNK_STREAM_COUNT=2
CONFIG_BT_BAP_BASS_MAX_SUBGROUPS=2
CONFIG_BT_BUF_ACL_RX_SIZE=255
CONFIG_BT_BUF_ACL_TX_SIZE=251
CONFIG_BT_AUDIO_CODEC_CFG_MAX_METADATA_SIZE=64
CONFIG_BT_AUDIO_CODEC_CFG_MAX_DATA_SIZE=64
CONFIG_BT_AUDIO_CODEC_CAP_MAX_METADATA_SIZE=64
CONFIG_BT_AUDIO_CODEC_CAP_MAX_DATA_SIZE=64

CONFIG_BT_DEVICE_NAME="Broadcast Audio Sink"
CONFIG_LOG_DEFAULT_LEVEL=3
```

## src/hw_codec.c
```c
/**
 * @file
 * @brief Bluetooth BAP Broadcast Sink audio codec integration
 *
 * This file handles all the audio codec hardware integration for the sample
 *
 * Copyright (c) 2025 SiFli Technologies(Nanjing) Co., Ltd
 *
 * SPDX-License-Identifier: Apache-2.0
 */

#include <errno.h>
#include <stdbool.h>
#include <stddef.h>
#include <stdint.h>

#include <zephyr/autoconf.h>
#include <zephyr/device.h>
#include <zephyr/devicetree.h>
#include <zephyr/kernel.h>
#include <zephyr/logging/log.h>
#include <zephyr/audio/codec.h>
#include <zephyr/sys/ring_buffer.h>
#include <zephyr/toolchain.h>

LOG_MODULE_REGISTER(codec, CONFIG_LOG_DEFAULT_LEVEL);

#define CODEC_MAX_BLOCK_SIZE 960U

/*
 * Default speaker/output volume sent via AUDIO_PROPERTY_OUTPUT_VOLUME.
 *
 * The valid numeric range and exact mapping to dB are codec‑dependent;
 * refer to the specific codec driver / datasheet for details. The value
 * 15 was selected as a conservative, comfortable default for this sample
 * application. Adjust as needed to match the desired default output level.
 */
#define SPEAKER_VOL 15U

/*
 * Total size of the ring buffer used to queue audio data for the codec.
 *
 * The buffer is sized to hold 20 maximum-size blocks. Having multiple
 * blocks queued reduces the likelihood of underruns when the producer is
 * briefly delayed, while still keeping overall latency and RAM usage
 * bounded. Increasing the multiplier adds buffering (and latency / RAM
 * consumption); decreasing it reduces buffering but makes underruns more
 * likely on a busy system.
 */
#define RING_BUF_SIZE (CODEC_MAX_BLOCK_SIZE * 20U)

static uint8_t ring_buffer[RING_BUF_SIZE];
static struct ring_buf rb;
static bool codec_configured;
static uint8_t block_data[CODEC_MAX_BLOCK_SIZE];
static const struct device *g_dev;
static uint32_t codec_block_size;

static void tx_done(const struct device *dev, void *user_data)
{
	uint32_t avail;
	uint32_t read;
	int written;

	ARG_UNUSED(user_data);

	avail = ring_buf_size_get(&rb);
	if (avail < codec_block_size) {
		LOG_WRN("Buffer does not have enough data for a full block");
		return;
	}

	read = ring_buf_get(&rb, block_data, codec_block_size);
	if (read != codec_block_size) {
		LOG_WRN("Failed to read full block from ring buffer: %u bytes", read);
		return;
	}

	written = audio_codec_write(dev, block_data, codec_block_size);
	if (written != 0) {
		LOG_WRN("Failed to write block data to audio device: %d", written);
		return;
	}
}

int hw_codec_open(void)
{
	g_dev = DEVICE_DT_GET(DT_ALIAS(codec0));
	if (!device_is_ready(g_dev)) {
		LOG_ERR("Could not open codec device");
		return -EIO;
	}
	ring_buf_init(&rb, RING_BUF_SIZE, ring_buffer);
	return 0;
}

int hw_codec_cfg(uint32_t samplerate, uint32_t block_size)
{
	int ret;
	audio_property_value_t val = {.vol = SPEAKER_VOL};
	struct audio_codec_cfg cfg = {
		.dai_type = AUDIO_DAI_TYPE_PCM,
		.dai_cfg.pcm.dir = AUDIO_DAI_DIR_TX,
		.dai_cfg.pcm.pcm_width = AUDIO_PCM_WIDTH_16_BITS,
		.dai_cfg.pcm.channels = 1U,
		.dai_cfg.pcm.block_size = block_size,
		.dai_cfg.pcm.samplerate = samplerate,
	};

	if (block_size == 0U || block_size > CODEC_MAX_BLOCK_SIZE) {
		return -EINVAL;
	}

	if (codec_configured) {
		LOG_WRN("Already configured");
		return -EALREADY;
	}

	codec_block_size = block_size;
	LOG_INF("codec: samplerate=%d block_size=%d", samplerate, codec_block_size);
	audio_codec_register_done_callback(g_dev, tx_done, NULL, NULL, NULL);
	ret = audio_codec_configure(g_dev, &cfg);
	if (ret != 0) {
		LOG_ERR("Failed to configure codec (err %d)", ret);
		return ret;
	}

	ret = audio_codec_start(g_dev, AUDIO_DAI_DIR_TX);
	if (ret != 0) {
		LOG_ERR("Failed to start codec (err %d)", ret);
		return ret;
	}

	ret = audio_codec_set_property(g_dev, AUDIO_PROPERTY_OUTPUT_VOLUME, 0, val);
	if (ret != 0) {
		LOG_ERR("Failed to set codec output volume (err %d)", ret);
		if (audio_codec_stop(g_dev, AUDIO_DAI_DIR_TX) < 0) {
			LOG_ERR("Failed to stop codec");
		}
		return ret;
	}
	codec_configured = true;

	return 0;
}

uint32_t hw_codec_write_data(const uint8_t *data, uint32_t len)
{
	uint32_t bytes_put;

	bytes_put = ring_buf_put(&rb, data, len);
	if (bytes_put != len) {
		LOG_WRN("Buffer full, only added %u bytes", bytes_put);
	}
	return bytes_put;
}

int hw_codec_close(void)
{
	if (g_dev != NULL && codec_configured) {
		int ret = audio_codec_stop(g_dev, AUDIO_DAI_DIR_TX);

		if (ret < 0) {
			return ret;
		}
		ring_buf_reset(&rb);
		codec_configured = false;
		return 0;
	} else {
		return -EIO;
	}
}
```

## src/hw_codec.h
```c
/**
 * @file
 * @brief Bluetooth BAP Broadcast Sink sample audio codec header
 *
 * This file declares the audio codec related functionality for the sample
 *
 * Copyright (c) 2025 SiFli Technologies(Nanjing) Co., Ltd
 *
 * SPDX-License-Identifier: Apache-2.0
 */

#ifndef SAMPLE_BAP_BROADCAST_SINK_HW_CODEC_H
#define SAMPLE_BAP_BROADCAST_SINK_HW_CODEC_H
#include <stddef.h>
#include <stdint.h>

/**
 * @brief Open and initialize the audio codec.
 *
 * This function prepares the audio codec for use, allocating and
 * initializing any required resources.
 *
 * @retval 0        On success.
 * @return negative On failure, with a negative error code.
 */
int hw_codec_open(void);

/**
 * @brief Configure the audio codec sampling rate.
 *
 * This function applies the desired sampling rate to the audio codec.
 * It must be called after @ref hw_codec_open and before sending
 * audio data with @ref hw_codec_write_data.
 *
 * @param samplerate Sampling rate in Hz (for example, 48000 for 48 kHz).
 * @param block_size Number of PCM bytes in one DMA block.
 *
 * @retval 0        On success.
 * @retval -EALREADY If the codec is already configured.
 * @return negative  On other failures, with a negative error code.
 */
int hw_codec_cfg(uint32_t samplerate, uint32_t block_size);

/**
 * @brief Write audio data to the codec for playback.
 *
 * This function sends raw audio samples to the codec. It should be
 * called after the codec has been opened and configured.
 *
 * @param data Pointer to the buffer containing audio data.
 * @param len  Number of bytes of audio data to write.
 *
 * @return The number of bytes successfully queued in the internal buffer.
 *         A value less than @p len indicates a partial enqueue. The actual
 *         transfer of the queued data to the codec hardware happens
 *         asynchronously.
 */
uint32_t hw_codec_write_data(const uint8_t *data, uint32_t len);

/**
 * @brief Close the audio codec and release resources.
 *
 * This function stops the codec if necessary and frees any resources
 * that were allocated by @ref hw_codec_open.
 *
 * @retval 0    On success.
 * @retval -EIO If the codec has not been opened or configured.
 */
int hw_codec_close(void);

#endif /* SAMPLE_BAP_BROADCAST_SINK_HW_CODEC_H */
```

## src/lc3.c
```c
/**
 * @file
 * @brief Bluetooth BAP Broadcast Sink LC3 extension
 *
 * This files handles all the LC3 related functionality for the sample
 *
 * Copyright (c) 2025 Nordic Semiconductor ASA
 *
 * SPDX-License-Identifier: Apache-2.0
 */

#include <errno.h>
#include <stdbool.h>
#include <stddef.h>
#include <stdint.h>
#include <string.h>

#include <zephyr/autoconf.h>
#include <zephyr/bluetooth/assigned_numbers.h>
#include <zephyr/bluetooth/audio/audio.h>
#include <zephyr/bluetooth/hci_types.h>
#include <zephyr/bluetooth/iso.h>
#include <zephyr/device.h>
#include <zephyr/devicetree.h>
#include <zephyr/kernel.h>
#include <zephyr/kernel/thread_stack.h>
#include <zephyr/logging/log.h>
#include <zephyr/logging/log_core.h>
#include <zephyr/net_buf.h>
#include <zephyr/shell/shell.h>
#include <zephyr/sys/ring_buffer.h>
#include <zephyr/sys/util.h>
#include <zephyr/sys/util_macro.h>
#include <zephyr/sys_clock.h>
#include <zephyr/toolchain.h>
#include <zephyr/usb/usb_device.h>
#include <zephyr/usb/class/usb_audio.h>

#include <lc3.h>

#include "lc3.h"
#include "stream_rx.h"
#include "usb.h"
#include "hw_codec.h"

LOG_MODULE_REGISTER(lc3, CONFIG_LOG_DEFAULT_LEVEL);

struct lc3_data {
	void *fifo_reserved; /* 1st word reserved for use by FIFO */
	struct net_buf *buf;
	struct stream_rx *stream;
	uint32_t ts;
	bool do_plc;
};

K_MEM_SLAB_DEFINE_STATIC_TYPE(lc3_data_slab, struct lc3_data, CONFIG_BT_ISO_RX_BUF_COUNT);

static int16_t lc3_rx_buf[LC3_MAX_NUM_SAMPLES_MONO];
static K_FIFO_DEFINE(lc3_in_fifo);

/* We only want to send USB to left/right from a single stream. If we have 2 left streams, the
 * outgoing audio is going to be terrible.
 * Since a stream can contain stereo data, both of these may be the same stream.
 */
static struct stream_rx *usb_left_stream;
static struct stream_rx *usb_right_stream;
static struct stream_rx *codec_stream;

static int init_lc3_decoder(struct stream_rx *stream, uint32_t lc3_frame_duration_us,
			    uint32_t lc3_freq_hz)
{
	if (stream == NULL) {
		LOG_ERR("NULL stream to init LC3 decoder");
		return -EINVAL;
	}

	if (stream->lc3_decoder != NULL) {
		LOG_ERR("Already initialized");
		return -EALREADY;
	}

	if (lc3_freq_hz == 0U || lc3_frame_duration_us == 0U) {
		LOG_ERR("Invalid freq (%u) or frame duration (%u)", lc3_freq_hz,
			lc3_frame_duration_us);

		return -EINVAL;
	}

	LOG_INF("Initializing the LC3 decoder with %u us duration and %u Hz frequency",
		lc3_frame_duration_us, lc3_freq_hz);
	/* Create the decoder instance. This shall complete before stream_started() is called. */
	stream->lc3_decoder =
		lc3_setup_decoder(lc3_frame_duration_us, lc3_freq_hz,
				  IS_ENABLED(CONFIG_USE_USB_AUDIO_OUTPUT) ? USB_SAMPLE_RATE_HZ : 0,
				  &stream->lc3_decoder_mem);
	if (stream->lc3_decoder == NULL) {
		LOG_ERR("Failed to setup LC3 decoder - wrong parameters?\n");
		return -EINVAL;
	}

	LOG_INF("Initialized LC3 decoder for %p", stream);

	return 0;
}

static bool decode_frame(struct lc3_data *data, size_t frame_cnt)
{
	const struct stream_rx *stream = data->stream;
	const size_t total_frames = stream->lc3_chan_cnt * stream->lc3_frame_blocks_per_sdu;
	const uint16_t octets_per_frame = stream->lc3_octets_per_frame;
	struct net_buf *buf = data->buf;
	void *iso_data;
	int err;

	if (data->do_plc) {
		iso_data = NULL; /* perform PLC */

#if CONFIG_INFO_REPORTING_INTERVAL > 0
		if ((stream->reporting_info.lc3_decoded_cnt % CONFIG_INFO_REPORTING_INTERVAL) ==
		    0) {
			LOG_DBG("[%zu]: Performing PLC", stream->reporting_info.lc3_decoded_cnt);
		}
#endif /* CONFIG_INFO_REPORTING_INTERVAL > 0 */
	} else {
		iso_data = net_buf_pull_mem(data->buf, octets_per_frame);

#if CONFIG_INFO_REPORTING_INTERVAL > 0
		if ((stream->reporting_info.lc3_decoded_cnt % CONFIG_INFO_REPORTING_INTERVAL) ==
		    0) {
			LOG_DBG("[%zu]: Decoding frame of size %u (%u/%u)",
				stream->reporting_info.lc3_decoded_cnt, octets_per_frame,
				frame_cnt + 1, total_frames);
		}
#endif /* CONFIG_INFO_REPORTING_INTERVAL > 0 */
	}

	err = lc3_decode(stream->lc3_decoder, iso_data, octets_per_frame, LC3_PCM_FORMAT_S16,
			 lc3_rx_buf, 1);
	if (err < 0) {
		LOG_ERR("Failed to decode LC3 data (%u/%u - %u/%u)", frame_cnt + 1, total_frames,
			octets_per_frame * frame_cnt, buf->len);
		return false;
	}

	return true;
}

static int get_lc3_chan_alloc_from_index(const struct stream_rx *stream, uint8_t index,
					 enum bt_audio_location *chan_alloc)
{
#if defined(CONFIG_USE_USB_AUDIO_OUTPUT)
	const bool has_left = (stream->lc3_chan_allocation & BT_AUDIO_LOCATION_FRONT_LEFT) != 0;
	const bool has_right = (stream->lc3_chan_allocation & BT_AUDIO_LOCATION_FRONT_RIGHT) != 0;
	const bool is_mono = stream->lc3_chan_allocation == BT_AUDIO_LOCATION_MONO_AUDIO;
	const bool is_left = index == 0 && has_left;
	const bool is_right = has_right && (index == 0U || (index == 1U && has_left));

	/* LC3 is always Left before Right, so we can use the index and the stream channel
	 * allocation to determine if index 0 is left or right.
	 */
	if (is_left) {
		*chan_alloc = BT_AUDIO_LOCATION_FRONT_LEFT;
	} else if (is_right) {
		*chan_alloc = BT_AUDIO_LOCATION_FRONT_RIGHT;
	} else if (is_mono) {
		*chan_alloc = BT_AUDIO_LOCATION_MONO_AUDIO;
	} else {
		/* Not suitable for USB */
		return -EINVAL;
	}

	return 0;
#else  /* !CONFIG_USE_USB_AUDIO_OUTPUT */
	return -EINVAL;
#endif /* CONFIG_USE_USB_AUDIO_OUTPUT */
}

static int usb_add_frame(const struct stream_rx *stream, int chn, uint32_t ts)
{
	enum bt_audio_location chan_alloc;
	int err;

	err = get_lc3_chan_alloc_from_index(stream, chn, &chan_alloc);
	if (err != 0) {
		/* Not suitable for USB */
		return err;
	}
	/* We only want to left or right from one stream to USB */
	if ((chan_alloc == BT_AUDIO_LOCATION_FRONT_LEFT && stream != usb_left_stream) ||
		(chan_alloc == BT_AUDIO_LOCATION_FRONT_RIGHT && stream != usb_right_stream)) {
		return -EIO;
	}
	/* TODO: Add support for properly support the presentation delay.
	 * For now we just send audio to USB as soon as we get it
	 */
	return usb_add_frame_to_usb(chan_alloc, lc3_rx_buf, sizeof(lc3_rx_buf), ts);
}

static int codec_add_frame(const struct stream_rx *stream, int chn, uint32_t ts)
{
	ARG_UNUSED(ts);
	const uint32_t pcm_size = (stream->lc3_frame_duration_us * stream->lc3_freq_hz /
				   USEC_PER_SEC) * sizeof(lc3_rx_buf[0]);
	uint32_t bytes_put;

	if (stream != codec_stream || chn != 0) {
		return 0;
	}

	bytes_put = hw_codec_write_data((const uint8_t *)lc3_rx_buf, pcm_size);
	return bytes_put == pcm_size ? 0 : -ENOMEM;
}

static size_t decode_frame_block(struct lc3_data *data, size_t frame_cnt)
{
	const struct stream_rx *stream = data->stream;
	const uint8_t chan_cnt = stream->lc3_chan_cnt;
	size_t decoded_frames = 0U;
	int ret = 0;

	for (uint8_t i = 0U; i < chan_cnt; i++) {
		/* We provide the total number of decoded frames to `decode_frame` for logging
		 * purposes
		 */
		if (decode_frame(data, frame_cnt + decoded_frames)) {
			decoded_frames++;
			if (IS_ENABLED(CONFIG_USE_CODEC_AUDIO_OUTPUT)) {
				ret = codec_add_frame(stream, i, data->ts);
				if (ret != 0) {
					LOG_ERR("codec_add_frame failed: %d", ret);
					continue;
				}
			}
			if (IS_ENABLED(CONFIG_USE_USB_AUDIO_OUTPUT)) {
				ret = usb_add_frame(stream, i, data->ts);
				if (ret != 0) {
					LOG_ERR("usb_add_frame failed: %d", ret);
					continue;
				}
			}
		} else {
			/* If decoding failed, we clear the data to USB as it would contain
			 * invalid data
			 */
			if (IS_ENABLED(CONFIG_USE_USB_AUDIO_OUTPUT)) {
				usb_clear_frames_to_usb();
			}
			break;
		}
	}
	return decoded_frames;
}

static void do_lc3_decode(struct lc3_data *data)
{
	struct stream_rx *stream = data->stream;

	if (stream->lc3_decoder != NULL) {
		const uint8_t frame_blocks_per_sdu = stream->lc3_frame_blocks_per_sdu;
		size_t frame_cnt;

		frame_cnt = 0U;
		for (uint8_t i = 0U; i < frame_blocks_per_sdu; i++) {
			const size_t decoded_frames = decode_frame_block(data, frame_cnt);

			if (decoded_frames == 0U) {
				break;
			}

			frame_cnt += decoded_frames;
		}

#if CONFIG_INFO_REPORTING_INTERVAL > 0
		stream->reporting_info.lc3_decoded_cnt++;
#endif /* CONFIG_INFO_REPORTING_INTERVAL > 0 */
	}

	net_buf_unref(data->buf);
}

static void lc3_decoder_thread_func(void *arg1, void *arg2, void *arg3)
{
	ARG_UNUSED(arg1);
	ARG_UNUSED(arg2);
	ARG_UNUSED(arg3);

	while (true) {
		struct lc3_data *data = k_fifo_get(&lc3_in_fifo, K_FOREVER);
		struct stream_rx *stream = data->stream;

		if (stream->lc3_decoder == NULL) {
			LOG_WRN("Decoder is NULL, discarding data from FIFO");
			k_mem_slab_free(&lc3_data_slab, (void *)data);
			continue; /* Wait for new data */
		}

		do_lc3_decode(data);

		k_mem_slab_free(&lc3_data_slab, (void *)data);
	}
}

int lc3_enable(struct stream_rx *stream)
{
	const struct bt_audio_codec_cfg *codec_cfg = stream->stream.codec_cfg;
	uint32_t lc3_frame_duration_us = 0U;
	uint32_t lc3_freq_hz = 0U;
	int ret;

	if (codec_cfg->id != BT_HCI_CODING_FORMAT_LC3) {
		return -EINVAL;
	}

	ret = bt_audio_codec_cfg_get_freq(codec_cfg);
	if (ret >= 0) {
		ret = bt_audio_codec_cfg_freq_to_freq_hz(ret);

		if (ret > 0) {
			if (ret == 8000 || ret == 16000 || ret == 24000 || ret == 32000 ||
			    ret == 48000) {
				lc3_freq_hz = (uint32_t)ret;
			} else {
				LOG_ERR("Unsupported frequency for LC3: %d", ret);
			}
		} else {
			LOG_ERR("Invalid frequency: %d", ret);
		}
	} else {
		LOG_ERR("Could not get frequency: %d", ret);
	}

	if (lc3_freq_hz == 0U) {
		return -EINVAL;
	}

	ret = bt_audio_codec_cfg_get_frame_dur(codec_cfg);
	if (ret >= 0) {
		ret = bt_audio_codec_cfg_frame_dur_to_frame_dur_us(ret);
		if (ret > 0) {
			lc3_frame_duration_us = (uint32_t)ret;
		} else {
			LOG_ERR("Invalid frame duration: %d", ret);
		}
	} else {
		LOG_ERR("Could not get frame duration: %d", ret);
	}

	if (lc3_frame_duration_us == 0U) {
		return -EINVAL;
	}

	ret = bt_audio_codec_cfg_get_chan_allocation(codec_cfg, &stream->lc3_chan_allocation, true);
	if (ret == 0) {
		stream->lc3_chan_cnt = bt_audio_get_chan_count(stream->lc3_chan_allocation);
	} else {
		LOG_DBG("Could not get channel allocation: %d", ret);
		stream->lc3_chan_cnt = 0U;
	}

	if (stream->lc3_chan_cnt == 0U) {
		return -EINVAL;
	}

	stream->lc3_frame_duration_us = lc3_frame_duration_us;
	stream->lc3_freq_hz = lc3_freq_hz;

	ret = bt_audio_codec_cfg_get_frame_blocks_per_sdu(codec_cfg, true);
	if (ret >= 0) {
		stream->lc3_frame_blocks_per_sdu = (uint8_t)ret;
	} else {
		LOG_ERR("Could not get frame blocks per SDU: %d", ret);
		stream->lc3_frame_blocks_per_sdu = 0U;
	}

	if (stream->lc3_frame_blocks_per_sdu == 0U) {
		return -EINVAL;
	}

	ret = bt_audio_codec_cfg_get_octets_per_frame(codec_cfg);
	if (ret >= 0) {
		stream->lc3_octets_per_frame = (uint16_t)ret;
	} else {
		LOG_ERR("Could not get octets per frame: %d", ret);
		stream->lc3_octets_per_frame = 0U;
	}

	if (stream->lc3_octets_per_frame == 0U) {
		return -EINVAL;
	}

	if (stream->lc3_decoder == NULL) {
		const int err = init_lc3_decoder(stream, lc3_frame_duration_us, lc3_freq_hz);

		if (err != 0) {
			LOG_ERR("Failed to init LC3 decoder: %d", err);
			return err;
		}
	}

	if (IS_ENABLED(CONFIG_USE_USB_AUDIO_OUTPUT)) {
		if ((stream->lc3_chan_allocation & BT_AUDIO_LOCATION_FRONT_LEFT) != 0) {
			if (usb_left_stream == NULL) {
				LOG_INF("Setting USB left stream to %p", stream);
				usb_left_stream = stream;
			} else {
				LOG_WRN("Multiple left streams started");
			}
		}

		if ((stream->lc3_chan_allocation & BT_AUDIO_LOCATION_FRONT_RIGHT) != 0) {
			if (usb_right_stream == NULL) {
				LOG_INF("Setting USB right stream to %p", stream);
				usb_right_stream = stream;
			} else {
				LOG_WRN("Multiple right streams started");
			}
		}
	}

	if (IS_ENABLED(CONFIG_USE_CODEC_AUDIO_OUTPUT)) {
		const uint32_t pcm_size = (lc3_frame_duration_us * lc3_freq_hz / USEC_PER_SEC) *
					  sizeof(lc3_rx_buf[0]);

		if (codec_stream == NULL) {
			codec_stream = stream;
		}

		const int err = hw_codec_cfg(lc3_freq_hz, pcm_size);

		if ((err != 0) && (err != -EALREADY)) {
			LOG_ERR("Failed to configure codec: %d", err);
			return err;
		}
	}
	return 0;
}

int lc3_disable(struct stream_rx *stream)
{
	if (stream->lc3_decoder == NULL) {
		return -EINVAL;
	}

	stream->lc3_decoder = NULL;
	if (codec_stream == stream) {
		codec_stream = NULL;
	}

	if (IS_ENABLED(CONFIG_USE_USB_AUDIO_OUTPUT)) {
		if (usb_left_stream == stream) {
			usb_left_stream = NULL;
		}
		if (usb_right_stream == stream) {
			usb_right_stream = NULL;
		}
	}

	return 0;
}

void lc3_enqueue_for_decoding(struct stream_rx *stream, const struct bt_iso_recv_info *info,
			      struct net_buf *buf)
{
	const uint8_t frame_blocks_per_sdu = stream->lc3_frame_blocks_per_sdu;
	const uint16_t octets_per_frame = stream->lc3_octets_per_frame;
	const uint8_t chan_cnt = stream->lc3_chan_cnt;
	struct lc3_data *data;

	if (stream->lc3_decoder == NULL) {
		return;
	}

	/* Allocate a context that holds both the buffer and the stream so that we can
	 * send both of these values to the LC3 decoder thread as a single struct
	 * in a FIFO
	 */
	if (k_mem_slab_alloc(&lc3_data_slab, (void **)&data, K_NO_WAIT)) {
		LOG_WRN("Could not allocate LC3 data item");
		return;
	}
	(void)memset(data, 0, sizeof(*data));

	if ((info->flags & BT_ISO_FLAGS_VALID) == 0) {
		data->do_plc = true;
	} else if (buf->len != (octets_per_frame * chan_cnt * frame_blocks_per_sdu)) {
		if (buf->len != 0U) {
			LOG_WRN("Expected %u frame blocks with %u channels of size %u, but "
				"length is %u",
				frame_blocks_per_sdu, chan_cnt, octets_per_frame, buf->len);
		}

		data->do_plc = true;
	}

	data->buf = net_buf_ref(buf);
	data->stream = stream;
	if (info->flags & BT_ISO_FLAGS_TS) {
		data->ts = info->ts;
	} else {
		data->ts = 0U;
	}

	k_fifo_put(&lc3_in_fifo, data);
}

int lc3_init(void)
{
	static K_KERNEL_STACK_DEFINE(lc3_decoder_thread_stack, 4096);
	const int lc3_decoder_thread_prio = K_PRIO_PREEMPT(5);
	static struct k_thread lc3_decoder_thread;
	static bool initialized;

	if (initialized) {
		return -EALREADY;
	}

	k_thread_create(&lc3_decoder_thread, lc3_decoder_thread_stack,
			K_KERNEL_STACK_SIZEOF(lc3_decoder_thread_stack), lc3_decoder_thread_func,
			NULL, NULL, NULL, lc3_decoder_thread_prio, 0, K_NO_WAIT);
	k_thread_name_set(&lc3_decoder_thread, "LC3 Decoder");

	LOG_INF("LC3 initialized");
	initialized = true;

	return 0;
}
```

## src/stream_rx.h
```c
/*
 * Copyright (c) 2025 Nordic Semiconductor ASA
 *
 * SPDX-License-Identifier: Apache-2.0
 */
#ifndef SAMPLE_BAP_BROADCAST_SINK_STREAM_RX_H
#define SAMPLE_BAP_BROADCAST_SINK_STREAM_RX_H

#include <stddef.h>
#include <stdint.h>

#include <zephyr/autoconf.h>
#include <zephyr/bluetooth/assigned_numbers.h>
#include <zephyr/bluetooth/audio/audio.h>
#include <zephyr/bluetooth/audio/bap.h>
#include <zephyr/bluetooth/iso.h>
#include <zephyr/kernel.h>
#include <zephyr/net_buf.h>

#if defined(CONFIG_LIBLC3)
#include <lc3.h>
#endif /* defined(CONFIG_LIBLC3) */

struct stream_rx {
	/* A BAP stream object */
	struct bt_bap_stream stream;
#if CONFIG_INFO_REPORTING_INTERVAL > 0
	/** Struct containing information useful for logging purposes */
	struct {
		/** Total Number of SDUs received */
		size_t recv_cnt;
		/** Number of lost SDUs */
		size_t loss_cnt;
		/** Number of SDUs containing errors */
		size_t error_cnt;
		/** Number of valid SDUs received */
		size_t valid_cnt;
		/** Number of empty SDUs received */
		size_t empty_sdu_cnt;
		/** Number of SDUs with duplicated packet sequence number received */
		size_t dup_psn_cnt;
		/** Number of SDUs with duplicated timestamps received */
		size_t dup_ts_cnt;
		/** The last received timestamp to track dup_ts_cnt */
		uint32_t last_ts;
		/** The last received sequence number to track dup_psn_cnt */
		uint16_t last_seq_num;
#if CONFIG_LIBLC3 > 0
		/** Number of SDUs decoded  */
		size_t lc3_decoded_cnt;
#endif /* CONFIG_LIBLC3 > 0 */
	} reporting_info;
#endif /* CONFIG_INFO_REPORTING_INTERVAL > 0 */

#if defined(CONFIG_LIBLC3)
	/** Octets per frame - Used to validate that the incoming data is of correct size  */
	uint16_t lc3_octets_per_frame;
	/** Frame blocks per SDU - Used to split the SDU into frame blocks when decoding */
	uint8_t lc3_frame_blocks_per_sdu;

	/** Number of channels - Used to split the SDU into frame blocks when decoding */
	uint8_t lc3_chan_cnt;
	/** LC3 frame duration in microseconds */
	uint32_t lc3_frame_duration_us;
	/** LC3 sample rate in Hz */
	uint32_t lc3_freq_hz;

	/**
	 * @brief The configured channels of the stream
	 *
	 * Used to determine whether to send data to USB and count number of channels
	 */
	enum bt_audio_location lc3_chan_allocation;

	/** Memory use for the LC3 decoder - Supports any configuration */
	lc3_decoder_mem_48k_t lc3_decoder_mem;
	/** Reference to the LC3 decoder */
	lc3_decoder_t lc3_decoder;
#endif /* defined(CONFIG_LIBLC3) */
};

/**
 * @brief Function to call for each SDU received
 *
 * Will decode with LC3 and send to USB if enabled
 */
void stream_rx_recv(struct bt_bap_stream *bap_stream, const struct bt_iso_recv_info *info,
		    struct net_buf *buf);

size_t stream_rx_get_streaming_cnt(void);
int stream_rx_started(struct bt_bap_stream *bap_stream);
int stream_rx_stopped(struct bt_bap_stream *bap_stream);
void stream_rx_get_streams(
	struct bt_bap_stream *bap_streams[CONFIG_BT_BAP_BROADCAST_SNK_STREAM_COUNT]);

#endif /* SAMPLE_BAP_BROADCAST_SINK_STREAM_RX_H */
```
