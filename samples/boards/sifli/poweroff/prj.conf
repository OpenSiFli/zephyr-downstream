## CMakeLists.txt
```
# SPDX-License-Identifier: Apache-2.0

cmake_minimum_required(VERSION 3.20.0)
find_package(Zephyr REQUIRED HINTS $ENV{ZEPHYR_BASE})
project(sifli_system_off)

target_sources(app PRIVATE src/main.c)
```

## prj.conf
```kconfig
CONFIG_POWEROFF=y
```

## src/main.c
```c
/*
 * Copyright (c) 2019 Nordic Semiconductor ASA
 *
 * SPDX-License-Identifier: Apache-2.0
 */

#include <zephyr/kernel.h>

#include <zephyr/sys/poweroff.h>

int main(void)
{
	int rc;

	printk("\n%s system off demo\n", CONFIG_BOARD);

	sys_poweroff();

	return 0;
}
```
