## boards/sifli/sf32lb52_core_n16r16/Kconfig.sf32lb52_core_n16r16
```kconfig
# Copyright (c) 2025 Core Devices LLC
# SPDX-License-Identifier: Apache-2.0

config BOARD_SF32LB52_CORE_N16R16
	select SOC_SF32LB52JUD6
```

## boards/sifli/sf32lb52_core_n16r16/board.yml
```yaml
# Copyright (c) 2025 Core Devices LLC
# SPDX-License-Identifier: Apache-2.0

board:
  name: sf32lb52_core_n16r16
  full_name: SF32LB52-Core-N16R16
  vendor: sifli
  socs:
    - name: sf32lb52jud6
```

## boards/sifli/sf32lb52_core_n4/board.yml
```yaml
# Copyright (c) 2025 Core Devices LLC
# SPDX-License-Identifier: Apache-2.0

board:
  name: sf32lb52_core_n4
  full_name: SF32LB52-Core-N4
  vendor: sifli
  socs:
    - name: sf32lb52bu56
```

## boards/sifli/sf32lb52_devkit_lcd/Kconfig.defconfig
```kconfig
# Copyright (c) 2025 Core Devices LLC
# Copyright (c) 2025 SiFli Technologies(Nanjing) Co., Ltd
# SPDX-License-Identifier: Apache-2.0

if BOARD_SF32LB52_DEVKIT_LCD

if LVGL

config LV_Z_AREA_X_ALIGNMENT_WIDTH
	default 2

config LV_Z_AREA_Y_ALIGNMENT_WIDTH
	default 2

config LV_Z_FLUSH_THREAD
	default y

config LV_Z_DOUBLE_VDB
	default y

endif # LVGL

endif # BOARD_SF32LB52_DEVKIT_LCD
```

## boards/sifli/sf32lb52_nano_n16r16/board.yml
```yaml
# Copyright (c) 2025 Core Devices LLC
# SPDX-License-Identifier: Apache-2.0

board:
  name: sf32lb52_nano_n16r16
  full_name: SF32LB52-Nano-N16R16
  vendor: sifli
  socs:
    - name: sf32lb52jud6
```

## boards/sifli/sf32lb52_nano_n4/Kconfig.sf32lb52_nano_n4
```kconfig
# Copyright (c) 2025 Core Devices LLC
# SPDX-License-Identifier: Apache-2.0

config BOARD_SF32LB52_NANO_N4
	select SOC_SF32LB52BU56
```

## boards/sifli/sf32lb52_nano_n4/board.yml
```yaml
# Copyright (c) 2025 Core Devices LLC
# SPDX-License-Identifier: Apache-2.0

board:
  name: sf32lb52_nano_n4
  full_name: SF32LB52-Nano-N4
  vendor: sifli
  socs:
    - name: sf32lb52bu56
```

## boards/sifli/sf32lb52_wlan_core_n16r16/board.yml
```yaml
# Copyright (c) 2025 Core Devices LLC
# SPDX-License-Identifier: Apache-2.0

board:
  name: sf32lb52_wlan_core_n16r16
  full_name: SF32LB52-Wlan_Core-N16R16
  vendor: sifli
  socs:
    - name: sf32lb52jud6
```

## boards/sifli/sf32lb57x_spi_hdk_n16r4/Kconfig.sf32lb57x_spi_hdk_n16r4
```kconfig
# Copyright (c) 2025 Core Devices LLC
# SPDX-License-Identifier: Apache-2.0

config BOARD_SF32LB57X_SPI_HDK_N16R4
	select SOC_SF32LB573UB7N6
```

## boards/sifli/sf32lb57x_spi_hdk_n16r4/board.yml
```yaml
# Copyright (c) 2025 Core Devices LLC
# SPDX-License-Identifier: Apache-2.0

board:
  name: sf32lb57x_spi_hdk_n16r4
  full_name: SF32LB57X SPI HDK N16R4
  vendor: sifli
  socs:
    - name: sf32lb573ub7n6
```

## drivers/adc/Kconfig.sf32lb
```kconfig
# Copyright (c) 2025, Qingsong Gou <gouqs@hotmail.com>
# SPDX-License-Identifier: Apache-2.0

config ADC_SF32LB
	bool "ADC driver for SF32LB family of MCUs"
	default y
	depends on DT_HAS_SIFLI_SF32LB_GPADC_ENABLED
	imply OTP if $(dt_compat_any_has_prop,$(DT_COMPAT_SIFLI_SF32LB_GPADC),nvmem-cells)
	imply NVMEM if $(dt_compat_any_has_prop,$(DT_COMPAT_SIFLI_SF32LB_GPADC),nvmem-cells)
	help
	  Enable ADC driver for SF32LB series of MCUs

if ADC_SF32LB

config ADC_SF32LB_CALIBRATION
	bool "Apply SF32LB ADC factory calibration"
	default y
	help
	  Convert GPADC hardware codes through the SF32LB52X factory
	  calibration model before returning Zephyr ADC raw samples.
	  If no NVMEM calibration cell is available, SDK default calibration
	  constants are used.

endif # ADC_SF32LB
```

## drivers/display/Kconfig.co5300
```kconfig
# Copyright 2025 NXP
# Copyright 2025 SiFli Technologies(Nanjing) Co., Ltd
# SPDX-License-Identifier: Apache-2.0

config CO5300
	bool "CO5300 display driver"
	default y
	select MIPI_DSI
	depends on DT_HAS_CHIPONE_CO5300_ENABLED
	help
	  Enable driver for CO5300 display controller

config CO5300_QSPI
	bool "CO5300 QSPI display driver"
	default y
	select MIPI_DBI
	depends on DT_HAS_CHIPONE_CO5300_QSPI_ENABLED
	help
	  Enable driver for CO5300 display controller over QSPI display transport.
```

## drivers/i2s/Kconfig.sf32lb
```kconfig
# Copyright (c) 2026
# SPDX-License-Identifier: Apache-2.0

config I2S_SF32LB
	bool "SiFli SF32LB I2S driver (LL)"
	default y
	depends on DT_HAS_SIFLI_SF32LB_I2S_ENABLED
	select DMA
	help
	  Enable I2S driver for SF32LB MCUs using the low-level (LL)
	  abstraction layer.  This driver supports standard I2S,
	  Left-Justified, Right-Justified, and DSP/PCM serial audio
	  formats in both master and slave modes. Data transfers use DMA,
	  with asynchronous queue and memory-slab ownership semantics.
```

## drivers/serial/Kconfig.sf32lb
```kconfig
# Copyright (c) Core Devices LLC
# SPDX-License-Identifier: Apache-2.0

config UART_SF32LB
	bool "SiFli SF32LB UART driver"
	default y
	depends on DT_HAS_SIFLI_SF32LB_USART_ENABLED
	select SERIAL_HAS_DRIVER
	select SERIAL_SUPPORT_INTERRUPT
	select SERIAL_SUPPORT_ASYNC if DT_HAS_SIFLI_SF32LB_DMAC_ENABLED
	select DMA if UART_ASYNC_API
	select RING_BUFFER if UART_ASYNC_API
	select PINCTRL
	select CLOCK_CONTROL
	help
	  This option enables the SiFli SF32LB UART driver.

config UART_SF32LB_ASYNC_RX_IRQ_FIFO_SIZE
	int "Asynchronous UART RX interrupt fallback buffer size"
	depends on UART_SF32LB && UART_ASYNC_API
	range 2 32767
	default 128
	help
	  Size of the temporary buffer used by the normal-mode single-byte
	  asynchronous RX fallback.

config UART_SF32LB_ASYNC_RX_CYCLIC
	bool "Use cyclic DMA for asynchronous UART RX"
	depends on UART_SF32LB && UART_ASYNC_API && KERNEL_MEM_POOL
	default y
	help
	  Use a cyclic DMA buffer for asynchronous UART reception.

	  The driver allocates an internal DMA buffer from the system heap when
	  uart_rx_enable() is called. The buffer passed to uart_rx_enable()
	  remains the application-visible receive buffer. The application must
	  consume RX_RDY data before the internal DMA buffer wraps and overwrites
	  data that has not yet been copied out.

config UART_SF32LB_ASYNC_RX_BUFFER_SIZE
	int "Asynchronous UART RX cyclic buffer size"
	depends on UART_SF32LB_ASYNC_RX_CYCLIC
	range 2 65535
	default 512
	help
	  Size in bytes of the cyclic RX buffer allocated from the system
	  heap for each active SF32LB UART receiver.

config HEAP_MEM_POOL_ADD_SIZE_UART_SF32LB
	int
	depends on UART_SF32LB_ASYNC_RX_CYCLIC
	default UART_SF32LB_ASYNC_RX_BUFFER_SIZE

config HEAP_MEM_POOL_ADD_SIZE_UART_SF32LB_ALIGN
	int
	depends on UART_SF32LB_ASYNC_RX_CYCLIC
	default 64
```

## dts/bindings/adc/sifli,sf32lb-gpadc.yaml
```yaml
# Copyright (c) 2025 Qingsong Gou <gouqs@hotmail.com>
# SPDX-License-Identifier: Apache-2.0

description: SiFli SF32LB ADC controller

compatible: "sifli,sf32lb-gpadc"

include: [adc-controller.yaml, nvmem-consumer.yaml, pinctrl-device.yaml, sifli-sf32lb-cfg.yaml]

properties:
  reg:
    required: true

  interrupts:
    required: true

  clocks:
    required: true

  pinctrl-0:
    required: true

  pinctrl-names:
    required: true

  sifli,cfg:
    required: true

  sifli,calibration-source:
    type: string
    default: "auto"
    enum:
      - "auto"
      - "default"
      - "avdd-1v8"
    description: |
      Select which SF32LB52X eFuse ADC factory calibration group to use.
      "default" uses the normal Bank1 ADC calibration fields. "avdd-1v8"
      uses the second calibration group for letter-series chips whose ADC
      AVDD is supplied at 1.8 V. "auto" selects "avdd-1v8" only when the
      chip revision is letter-series and sifli,avdd-1v8 is present.

  sifli,avdd-1v8:
    type: boolean
    description: |
      Board-level indication that ADC AVDD is supplied at 1.8 V. This is
      used only when sifli,calibration-source is "auto".

  nvmem-cells:
    description: |
      Optional NVMEM cell containing the raw 32-byte SF32LB52X eFuse Bank1
      calibration region.

  nvmem-cell-names:
    description: |
      When nvmem-cells is present, it should contain a cell named
      "calibration".

  "#io-channel-cells":
    const: 1

io-channel-cells:
  - input
```

## dts/bindings/display/chipone,co5300-qspi.yaml
```yaml
# Copyright (c) 2026 SiFli Technologies(Nanjing) Co., Ltd
# SPDX-License-Identifier: Apache-2.0

title: Chipone CO5300 QSPI display controller

description: |
  DCS-compatible Chipone CO5300 display controller attached through a
  Quad-SPI/QPI style MIPI-DBI backend.

compatible: "chipone,co5300-qspi"

include:
  - name: mipi-dbi-device.yaml
    property-blocklist:
      - mipi-mode
  - display-controller.yaml

properties:
  reg:
    required: true

  mipi-max-frequency:
    required: true

  mipi-mode:
    type: string
    required: true
    description: |
      CO5300 QSPI panels must be attached through the QSPI display transport.
    enum:
      - "MIPI_DBI_MODE_QSPI"

  reset-gpios:
    type: phandle-array
    description: |
      GPIO connected to the reset pin. The asserted level is described by
      the GPIO flags in devicetree.

  avdd-enable-gpios:
    type: phandle-array
    description: |
      GPIO used to enable the panel AVDD supply.
```

## dts/bindings/display/sifli,sf32lb-lcdc.yaml
```yaml
# Copyright (c) 2025, Qingsong Gou <gouqs@hotmail.com>
# Copyright (c) 2025 SiFli Technologies(Nanjing) Co., Ltd
# SPDX-License-Identifier: Apache-2.0

description: Sifli SF32LB LCDC display controller

compatible: "sifli,sf32lb-lcdc"

include: base.yaml

properties:
  reg:
    required: true

  clocks:
    required: true

  interrupts:
    required: true
```

## dts/bindings/i2s/sifli,sf32lb-i2s.yaml
```yaml
# Copyright (c) 2026
# SPDX-License-Identifier: Apache-2.0

description: |
  SiFli SF32LB I2S (Inter-IC Sound) controller.

  The SF32LB I2S peripheral supports standard I2S, Left-Justified,
  Right-Justified, and DSP/PCM serial audio formats in both master
  and slave modes. It features independent TX and RX paths with
  programmable BCLK/LRCK dividers, DMA support, and a 10-band
  TX equalizer.

compatible: "sifli,sf32lb-i2s"

include: [i2s-controller.yaml, pinctrl-device.yaml]

properties:
  reg:
    required: true

  clocks:
    required: true

  interrupts:
    required: true

  dmas:
    description: |
      Optional DMA channel specifiers for TX and RX. When provided,
      the driver will use DMA for data transfers. Two channels are
      expected: one for TX and one for RX, in that order.
      Example:
        dmas = <&dmac 0 SF32LB52X_DMA_REQ_I2S1_TX SF32LB_DMA_PL_HIGH>,
               <&dmac 0 SF32LB52X_DMA_REQ_I2S1_RX SF32LB_DMA_PL_HIGH>;

  dma-names:
    description: |
      Must be "tx" and "rx" when dmas is present.

  pinctrl-0:
    required: true

  pinctrl-names:
    required: true
```

## dts/bindings/memory-controllers/sifli,sf32lb-mpi-opi-psram.yaml
```yaml
# Copyright (c) 2025 SiFli Technologies Co., Ltd.
# SPDX-License-Identifier: Apache-2.0

title: SiFli SF32LB Memory Peripheral Interface (MPI) in PSRAM mode.

description: |
  This driver supports PSRAM on SF32LB52x series chips. The PSRAM is
  connected to MPI1 and can operate in Xccela octal (OPI), Xccela legacy
  quad (QPI) or HyperBus (HyperRAM) mode, selected via the "sifli,protocol"
  property.

examples:
  - |
    &mpi1 {
      compatible = "sifli,sf32lb-mpi-opi-psram";
      reg = <0x50041000 0x1000>, <0x60000000 DT_SIZE_M(8)>;
      reg-names = "ctrl", "psram";
      clocks = <&rcc_clk SF32LB52X_CLOCK_MPI1>;
      pinctrl-0 = <&mpi1_default>;
      pinctrl-names = "default";
      power-supply = <&ldo1_1v8>;
      sifli,protocol = "xccela-opi";
      status = "okay";
    };

compatible: "sifli,sf32lb-mpi-opi-psram"

include: [base.yaml, pinctrl-device.yaml]

properties:
  reg:
    required: true
    description: |
      Memory-mapped addresses for MPI controller and PSRAM memory region.
      First entry is the MPI controller registers, second is the PSRAM
      memory-mapped region.

  reg-names:
    required: true
    description: |
      Names for the reg entries. Must be "ctrl" and "psram".

  clocks:
    required: true
    description: |
      Clock source for the MPI controller.

  power-supply:
    type: phandle
    description: |
      Reference to the regulator that supplies power to the PSRAM.
      For SF32LB525/527, this is typically the internal 1.8V LDO (ldo1_1v8).

  sifli,protocol:
    type: string
    required: false
    enum:
      - "xccela-opi"
      - "xccela-legacy"
      - "hyperram"
    default: "xccela-opi"
    description: |
      PSRAM interface protocol used on this MPI controller:
      - "xccela-opi":    Xccela octal (8-line DDR), used by SiP OPI PSRAM
      - "xccela-legacy": Xccela legacy (octal, 3-byte address, dual reset),
                         AP 32Mb PSRAM
      - "hyperram":      HyperBus, external HyperRAM
```

## dts/bindings/pinctrl/sifli,sf32lb57x-pinmux.yaml
```yaml
# Copyright (c) 2026 SiFli Technologies(Nanjing) Co., Ltd
# SPDX-License-Identifier: Apache-2.0

description: |
    SF32LB57x Pin multiplexer and pin configuration controller (HPSYS_PINMUX)

    Singleton node responsible for controlling pin function selection and pin
    properties. All device pin configurations should be placed in child nodes
    of the 'pinctrl' node.

    The SF32LB57x pinmux uses 8-bit function selectors and supports the
    standard pin properties listed below.

compatible: "sifli,sf32lb57x-pinmux"

include: [base.yaml, sifli-sf32lb-cfg.yaml]

properties:
  reg:
    required: true

  reg-names:
    required: true

  clocks:
    required: true

  sifli,cfg:
    required: true

  "#sifli,pinmux-cells":
    type: int
    const: 2

sifli,pinmux-cells:
  - port
  - offset

child-binding:
  child-binding:
    include:
      - name: pincfg-node.yaml
        property-allowlist:
          - bias-pull-down
          - bias-pull-up
          - input-enable
          - input-schmitt-enable
          - slew-rate
          - drive-strength

    properties:
      pinmux:
        required: true
        type: array
        description: |
          An array of pins sharing the same group properties. The pins should
          be defined using pre-defined macros or the SF32LB_PINMUX utility
          macro.

      slew-rate:
        default: 0
        description: |
          Select pin output slew rate. 0 selects slow slew rate and 1 selects
          fast slew rate.
        enum:
          - 0
          - 1

      drive-strength:
        default: 4
        enum:
          - 2
          - 4
          - 8
          - 12
          - 20
```

## samples/bluetooth/classic/spp_server/boards/sf32lb52_devkit_lcd.conf
```kconfig
# SPDX-License-Identifier: Apache-2.0

# SF32LB52 DevKit LCD board configuration for Bluetooth Classic SPP server

CONFIG_BT_BUF_ACL_RX_SIZE=512
CONFIG_BT_BUF_ACL_TX_SIZE=512
CONFIG_BT_BUF_ACL_TX_COUNT=8
CONFIG_BT_L2CAP_TX_MTU=204
CONFIG_BT_RFCOMM_L2CAP_MTU=200
CONFIG_HEAP_MEM_POOL_SIZE=8192
CONFIG_CRC_HW_HANDLER=n
CONFIG_SHELL=y
CONFIG_FILE_SYSTEM=y
CONFIG_FILE_SYSTEM_SHELL=y
CONFIG_FLASH=y
CONFIG_FLASH_MAP=y
CONFIG_FILE_SYSTEM_LITTLEFS=y
CONFIG_FS_LITTLEFS_CACHE_SIZE=4096
CONFIG_SYSTEM_WORKQUEUE_STACK_SIZE=8192
CONFIG_BT_RX_STACK_SIZE=4096
CONFIG_SPI=y
CONFIG_FLASH_SF32LB_MPI_QSPI_NOR=y
CONFIG_SPI_NOR=n
```

## soc/sifli/sf32/sf32lb57x/Kconfig
```kconfig
# Copyright (c) 2025 Core Devices LLC
# SPDX-License-Identifier: Apache-2.0

config SOC_SERIES_SF32LB57X
	select ARM
	select CPU_CORTEX_M33
	select CPU_HAS_ARM_MPU
	select CPU_HAS_ARM_SAU
	select CPU_HAS_FPU
	select ARMV8_M_DSP
	select CPU_HAS_ICACHE
	select CPU_HAS_DCACHE
	select SOC_EARLY_INIT_HOOK
	select HAS_POWEROFF

if SOC_SERIES_SF32LB57X

config SF32LB57X_BOOTROM_FLASH_ON_DELAY_MS
	int "Boot ROM flash on delay (ms)"
	default 0
	range 0 4095

config SF32LB57X_BOOTROM_FLASH_OFF_DELAY_MS
	int "Boot ROM flash off delay (ms)"
	default 0
	range 0 255

endif # SOC_SERIES_SF32LB57X
```
