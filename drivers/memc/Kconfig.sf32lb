## drivers/memc/Kconfig.sf32lb
```kconfig
# Copyright (c) 2025 SiFli Technologies Co., Ltd.
# SPDX-License-Identifier: Apache-2.0

config MEMC_SF32LB_MPI_OPI_PSRAM
	bool "SiFli SF32LB MPI OPI PSRAM driver"
	default y
	depends on DT_HAS_SIFLI_SF32LB_MPI_OPI_PSRAM_ENABLED
	depends on SOC_SERIES_SF32LB52X
	help
	  Enable the SiFli SF32LB MPI OPI PSRAM memory controller driver.
	  This driver supports internal OPI PSRAM on SF32LB52x series chips.
```

## samples/drivers/memc/boards/sf32lb52_devkit_lcd.conf
```kconfig
# SPDX-License-Identifier: Apache-2.0

CONFIG_MEMC=y
CONFIG_MEMC_SF32LB_MPI_OPI_PSRAM=y
CONFIG_LOG=y
CONFIG_MEMC_LOG_LEVEL_INF=y

# Regulator support for PSRAM LDO
CONFIG_REGULATOR=y
CONFIG_REGULATOR_SF32LB_LDO=y
```

## tests/drivers/memc/ram/boards/sf32lb52_devkit_lcd.conf
```kconfig
# SPDX-License-Identifier: Apache-2.0

CONFIG_MEMC_SF32LB_MPI_OPI_PSRAM=y

# Regulator support for PSRAM LDO
CONFIG_REGULATOR=y
CONFIG_REGULATOR_SF32LB_LDO=y
```
