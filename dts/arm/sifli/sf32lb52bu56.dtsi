/*
 * Copyright (c) 2025 Core Devices LLC
 * Copyright (c) 2025 SiFli Technologies(Nanjing) Co., Ltd
 * SPDX-License-Identifier: Apache-2.0
 */

#include <mem.h>

#include <zephyr/dt-bindings/dma/sf32lb52x-dma.h>

#include <sifli/sf32lb52x.dtsi>

/*
 * SF32LB52BU56: QFN68L, 3.3V supply, 45 GPIOs.
 * MPI1 SiP: 4MB QSPI NOR.
 */

/* Internal SiP QSPI NOR on MPI1, memory window at 0x60000000 (all masters) */
&mpi1 {
	compatible = "sifli,sf32lb-mpi-qspi-nor";
	reg = <0x50041000 0x1000>, <0x60000000 DT_SIZE_M(4)>;
	reg-names = "ctrl", "nor";
	dmas = <&dmac 0 SF32LB52X_DMA_REQ_MPI1 SF32LB_DMA_PL_MEDIUM>;
	sifli,lines = <4>;
	sifli,psclr = <0>;

	flash@0 {
		compatible = "jedec,qspi-nor";
		reg = <0x0>;
		size = <DT_SIZE_M(4)>;
		#address-cells = <1>;
		#size-cells = <1>;

		flash@60000000 {
			compatible = "soc-nv-flash";
			#address-cells = <1>;
			#size-cells = <1>;
			reg = <0x60000000 DT_SIZE_M(4)>;
			ranges = <0x0 0x60000000 DT_SIZE_M(4)>;
		};
	};
};

/* 45 GPIOs total (PA0..PA44): second bank 13 pins matches sf32lb52x.dtsi default */
